## config/west.yml
```yaml
manifest:
  remotes:
    - name: bdfranck
      url-base: https://github.com/bdfranck
  projects:
    - name: zmk
      remote: bdfranck
      revision: main
      import: app/west.yml
  self:
    path: config
```
